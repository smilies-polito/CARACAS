VERSION ""

NS_ :

BS_:

BU_: Brake_Lights Dashboard Battery_SOC Throttle_Control_ECU Speed_Control_ECU Motor

BO_ 5 SOC: 8 Battery_SOC
 SG_ SOC_signal : 0|64@1- (1,-20) [0|100] "" Vector__XXX

BO_ 4 Decel_Cmd_Message: 8 Throttle_Control_ECU
 SG_ Decel_Cmd_Signal : 0|64@1- (1,-20) [0|10000] "m/s^2" Vector__XXX

BO_ 3 Acceleration_Cmd_Message: 8 Throttle_Control_ECU
 SG_ Acceleration_CMD_Signal : 0|64@1- (1,-20) [0|10000] "m/s^2" Vector__XXX

BO_ 2 Velocity_Reference: 8 Speed_Control_ECU
 SG_ Velocity_Reference_Signal : 0|64@1- (1,-20) [0|10000] "m/s" Vector__XXX

BO_ 1 Velocity_Feedback: 8 Speed_Control_ECU
 SG_ Velocity_Feedback_Signal : 0|64@1- (1,-20) [0|10000] "m/s" Vector__XXX

BO_ 0 Motor_Torque: 8 Motor
 SG_ Motor_Torque_Signal : 0|64@1- (1,-20) [-50000|50000] "Nm" Vector__XXX

BA_DEF_  "BusType" STRING ;
BA_DEF_DEF_  "BusType" "CAN";
SIG_VALTYPE_ 5 SOC_signal : 2;
SIG_VALTYPE_ 4 Decel_Cmd_Signal : 2;
SIG_VALTYPE_ 3 Acceleration_CMD_Signal : 2;
SIG_VALTYPE_ 2 Velocity_Reference_Signal : 2;
SIG_VALTYPE_ 1 Velocity_Feedback_Signal : 2;
